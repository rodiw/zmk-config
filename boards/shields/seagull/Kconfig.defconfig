## boards/shields/seagull/Kconfig.defconfig
```kconfig
if SHIELD_SEAGULL

config ZMK_KEYBOARD_NAME
    default "Seagull"

config SPI
    default y

endif

if ZMK_DISPLAY

config I2C
    default y

config SSD1306
    default y

endif # ZMK_DISPLAY
```
